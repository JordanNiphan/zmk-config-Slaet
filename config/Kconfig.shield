## config/Kconfig.shield
```kconfig
# Copyright (c) 2024 Slaet Reteals
# SPDX-License-Identifier: MIT

config SHIELD_SLAET_LEFT
    def_bool $(shields_list_contains,slaet_left)

config SHIELD_SLAET_RIGHT
    def_bool $(shields_list_contains,slaet_right)
```

## config/boards/shields/Slaet-corne/Kconfig.defconfig
```kconfig
if SHIELD_SLAET-CORNE_LEFT

config ZMK_KEYBOARD_NAME
    default "SLAET-CORNE"

config ZMK_SPLIT_ROLE_CENTRAL
    default y

endif

if SHIELD_SLAET-CORNE_LEFT || SHIELD_SLAET-CORNE_RIGHT

config ZMK_SPLIT
    default y

endif
```

## config/boards/shields/Slaet-corne/Kconfig.shield
```kconfig
# Copyright (c) 2020 Pete Johanson
# SPDX-License-Identifier: MIT

config SHIELD_SLAET-CORNE_LEFT
    def_bool $(shields_list_contains,SlaetCorne_left)

config SHIELD_SLAET-CORNE_RIGHT
    def_bool $(shields_list_contains,SlaetCorne_right)
```

## config/boards/shields/slaet/Kconfig.defconfig
```kconfig
if SHIELD_SLAET_LEFT

    config ZMK_KEYBOARD_NAME
        default "Slaet-Reteals"

    config ZMK_SPLIT_ROLE_CENTRAL
        default y

endif #SHIELD_SLAET_LEFT

if SHIELD_SLAET_LEFT || SHIELD_SLAET_RIGHT

    config ZMK_SPLIT
        default y
    
    if LVGL

        config LV_Z_VDB_SIZE
            default 64

        config LV_DPI_DEF
            default 148

        config LV_Z_BITS_PER_PIXEL
            default 1

        choice LV_COLOR_DEPTH
            default LV_COLOR_DEPTH_1

    endchoice #LV_COLOR_DEPTH

    endif #LVGL

endif #SHIELD_SLAET_LEFT || SHIELD_SLAET_RIGHT
```

## config/boards/shields/slaet/Kconfig.shield
```kconfig
config SHIELD_SLAET_LEFT
    def_bool $(shields_list_contains,slaet_left)

config SHIELD_SLAET_RIGHT
    def_bool $(shields_list_contains,slaet_right)
    
```

## config/west.yml
```yaml
manifest:
  remotes:
    - name: zmkfirmware
      url-base: https://github.com/JordanNiphan/
  projects:
    - name: zmk
      remote: zmkfirmware
      revision: feat/pointers-move-scroll
      import: app/west.yml
  self:
    west-commands: scripts/west-commands.yml
    path: config
```

## slaet_kinesis/Kconfig.defconfig
```kconfig
# Copyright (c) 2024 Slaet Reteals
# SPDX-License-Identifier: MIT

if SHIELD_SLAET-KINESIS_LEFT

config ZMK_KEYBOARD_NAME
    default "slaet-kinesis"

config ZMK_SPLIT_ROLE_CENTRAL
    default y

endif

if SHIELD_SLAET-KINESIS_LEFT || SHIELD_SLAET-KINESIS_RIGHT

config ZMK_SPLIT
    default y

endif
```

## slaet_kinesis/Kconfig.shield
```kconfig
# Copyright (c) 2024 Slaet Reteals
# SPDX-License-Identifier: MIT

config SHIELD_SLAET-KINESIS_LEFT
    def_bool $(shields_list_contains,slaet_left)

config SHIELD_SLAET-KINESIS_RIGHT
    def_bool $(shields_list_contains,slaet_right)
```
