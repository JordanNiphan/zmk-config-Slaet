#include "slaet.dtsi"

&default_transform {
    col-offset = <8>;
};

&kscan0 {
    col-gpios
        = <&pro_micro 21 GPIO_ACTIVE_HIGH> #P0.31
        , <&pro_micro 20 GPIO_ACTIVE_HIGH> #P0.29
        , <&pro_micro 19 GPIO_ACTIVE_HIGH> #P0.02
        , <&pro_micro 18 GPIO_ACTIVE_HIGH> #P1.15
        , <&pro_micro 15 GPIO_ACTIVE_HIGH> #P1.13
        , <&pro_micro 14 GPIO_ACTIVE_HIGH> #P1.11
        , <&pro_micro 16 GPIO_ACTIVE_HIGH> #P0.10
        , <&pro_micro 10 GPIO_ACTIVE_HIGH> #P0.09
        ;
};
